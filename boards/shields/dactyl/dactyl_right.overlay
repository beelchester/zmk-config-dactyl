#include "dactyl.dtsi"

&default_transform {
    col-offset = <6>;
};

/ {
    chosen {
        zmk,kscan           = &kscan0;
        zmk,physical-layout = <&physical_layout_0>;
    };

    kscan0: kscan_0 {
        compatible = "zmk,kscan-gpio-matrix";
        diode-direction = "row2col";
        wakeup-source;

        col-gpios =
            <&pro_micro 7  (GPIO_ACTIVE_HIGH | GPIO_PULL_DOWN)>,  /* C6 */
            <&pro_micro 6  (GPIO_ACTIVE_HIGH | GPIO_PULL_DOWN)>,  /* C7 */
            <&pro_micro 5  (GPIO_ACTIVE_HIGH | GPIO_PULL_DOWN)>,  /* C8 */
            <&pro_micro 4  (GPIO_ACTIVE_HIGH | GPIO_PULL_DOWN)>,  /* C9 */
            <&pro_micro 3  (GPIO_ACTIVE_HIGH | GPIO_PULL_DOWN)>,  /* C10 */
            <&pro_micro 9  (GPIO_ACTIVE_HIGH | GPIO_PULL_DOWN)>;  /* C11 */

        row-gpios =
            <&pro_micro 18 GPIO_ACTIVE_HIGH>,  /* R0 */
            <&pro_micro 15 GPIO_ACTIVE_HIGH>,  /* R1 */
            <&pro_micro 14 GPIO_ACTIVE_HIGH>,  /* R2 */
            <&pro_micro 16 GPIO_ACTIVE_HIGH>,  /* R3 */
            <&pro_micro 10 GPIO_ACTIVE_HIGH>;  /* R4 */
    };
};

