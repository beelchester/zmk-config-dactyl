#include "dactyl.dtsi"

/ {
    chosen {
        zmk,kscan           = &kscan0;
        zmk,physical-layout = <&physical_layout_0>;
    };

    kscan0: kscan_0 {
        compatible = "zmk,kscan-gpio-matrix";
        diode-direction = "row2col";
        wakeup-source;

        col-gpios = 
            <&pro_micro 8  (GPIO_ACTIVE_HIGH | GPIO_PULL_DOWN)>,  /* C0 */
            <&pro_micro 9  (GPIO_ACTIVE_HIGH | GPIO_PULL_DOWN)>,  /* C1 */
            <&pro_micro 7  (GPIO_ACTIVE_HIGH | GPIO_PULL_DOWN)>,  /* C2 */
            <&pro_micro 6  (GPIO_ACTIVE_HIGH | GPIO_PULL_DOWN)>,  /* C3 */
            <&pro_micro 5  (GPIO_ACTIVE_HIGH | GPIO_PULL_DOWN)>,  /* C4 */
            <&pro_micro 4  (GPIO_ACTIVE_HIGH | GPIO_PULL_DOWN)>;  /* C5 */

        row-gpios = 
            <&pro_micro 18 GPIO_ACTIVE_HIGH>,  /* R0 */
            <&pro_micro 15 GPIO_ACTIVE_HIGH>,  /* R1 */
            <&pro_micro 14 GPIO_ACTIVE_HIGH>,  /* R2 */
            <&pro_micro 16 GPIO_ACTIVE_HIGH>,  /* R3 */
            <&pro_micro 10 GPIO_ACTIVE_HIGH>;  /* R4 */
    };
};

